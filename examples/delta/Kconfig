## examples/delta/Kconfig
```kconfig
config EXAMPLES_DELTA
	tristate "δ C2 scheduling benchmark for openvela S3"
	default n
	depends on PTHREAD_MUTEX_TYPES
	---help---
		Ports the C2 dependency-graph scheduler to NuttX RTOS and
		benchmarks three scheduling strategies (B_seq / B_systemd / C2)
		on a 4-task IMU processing pipeline. Reports measured speedup.

if EXAMPLES_DELTA

config EXAMPLES_DELTA_PROGNAME
	string "Program name"
	default "delta_bench"

config EXAMPLES_DELTA_PRIORITY
	int "Task priority"
	default 100

config EXAMPLES_DELTA_STACKSIZE
	int "Stack size"
	default 8192

config EXAMPLES_DELTA_TFLITE
	bool "Use real TFLite Micro inference in infer task"
	default n
	depends on TFLITEMICRO
	---help---
		Replace the simulated infer usleep with actual TFLite Micro
		inference (hello_world_int8). Requires CONFIG_TFLITEMICRO_HELLO.

endif
```

## examples/httpnode/Kconfig
```kconfig
config EXAMPLES_HTTPNODE
	tristate "HTTP Node Dashboard"
	default n
	depends on NET_TCP && SCHED_LPWORK
	---help---
		Minimal HTTP server providing a real-time node status dashboard.
		Displays IP, uptime, AI inference stats, peer discovery, heartbeat.
		No filesystem required — HTML is inlined.

if EXAMPLES_HTTPNODE

config EXAMPLES_HTTPNODE_PROGNAME
	string "Program name"
	default "httpnode"

config EXAMPLES_HTTPNODE_PRIORITY
	int "Task priority"
	default 100

config EXAMPLES_HTTPNODE_STACKSIZE
	int "Stack size"
	default 8192

endif
```

## examples/inferd/Kconfig
```kconfig
config EXAMPLES_INFERD
	tristate "Distributed Inference Daemon"
	default n
	depends on NET_TCP

config EXAMPLES_INFERD_TFLITE
	bool "Use real TFLite Micro inference (requires TFLITEMICRO)"
	default n
	depends on EXAMPLES_INFERD && TFLITEMICRO
	---help---
		Distributed TFLite Micro inference daemon for openvela ESP32-S3 mesh.
		Supports local benchmark, TCP worker (server), and offload bench modes.

if EXAMPLES_INFERD

config EXAMPLES_INFERD_PROGNAME
	string "Program name"
	default "inferd"

config EXAMPLES_INFERD_PRIORITY
	int "Task priority"
	default 100

config EXAMPLES_INFERD_STACKSIZE
	int "Stack size"
	default 8192

endif
```

## examples/lednode/Kconfig
```kconfig
config EXAMPLES_LEDNODE
	tristate "WS2812 RGB LED feedback daemon (lednode)"
	default n
	depends on ESP_RMT && RMTCHAR
	---help---
		RGB LED animation daemon for openvela ESP32-S3 nodes.
		Provides visual feedback for WiFi state, AI inference,
		heartbeat, HTTP requests, and CPU load via the on-board
		WS2812 LED (GPIO48 or GPIO38) driven through /dev/rmt0.

		Run with: nsh> lednode &

		Other apps (httpnode, inferd) call lednode_base() /
		lednode_flash() macros from lednode.h to signal events.
		In NuttX flat/builtin mode all tasks share the same address
		space, so the shared globals work without IPC overhead.
```

## examples/nodedisc/Kconfig
```kconfig
config EXAMPLES_NODEDISC
	tristate "openvela Node Discovery + Auto-connect"
	default n
	depends on NET_UDP && NET_TCP
	---help---
		UDP broadcast discovery (compatible with netutils/discover daemon)
		followed by automatic TCP nodelink connection to the first found peer.
		Measures discovery latency and connection speed for scoring.

if EXAMPLES_NODEDISC

config EXAMPLES_NODEDISC_PROGNAME
	string "Program name"
	default "nodedisc"

config EXAMPLES_NODEDISC_PRIORITY
	int "Task priority"
	default 100

config EXAMPLES_NODEDISC_STACKSIZE
	int "Stack size"
	default 4096

endif

config EXAMPLES_NODELINK_DAEMON
	tristate "openvela Nodelink Daemon (heartbeat + auto-reconnect)"
	default n
	depends on NET_UDP && NET_TCP
	---help---
		Persistent connection daemon with heartbeat and automatic
		discovery-based reconnection. Demonstrates 断连重连机制 (5 pts).

if EXAMPLES_NODELINK_DAEMON

config EXAMPLES_NODELINK_DAEMON_PROGNAME
	string "Program name"
	default "nodelink_daemon"

config EXAMPLES_NODELINK_DAEMON_PRIORITY
	int "Task priority"
	default 100

config EXAMPLES_NODELINK_DAEMON_STACKSIZE
	int "Stack size"
	default 4096

endif
```

## examples/nodelink/Kconfig
```kconfig
config EXAMPLES_NODELINK
	tristate "Node-Link: openvela node status reporter"
	default n
	depends on NET_TCP
	---help---
		Periodic TCP status reporter for openvela inter-node demo.
		Connects to a server and sends JSON-formatted node status.

if EXAMPLES_NODELINK

config EXAMPLES_NODELINK_PROGNAME
	string "Program name"
	default "nodelink"

config EXAMPLES_NODELINK_PRIORITY
	int "Task priority"
	default 100

config EXAMPLES_NODELINK_STACKSIZE
	int "Stack size"
	default 4096

config EXAMPLES_NODELINK_SERVER_IP
	string "Server IP address"
	default "192.168.101.20"

config EXAMPLES_NODELINK_SERVER_PORT
	int "Server TCP port"
	default 4444

config EXAMPLES_NODELINK_INTERVAL_MS
	int "Send interval (ms)"
	default 2000

config EXAMPLES_NODELINK_UDP
	bool "Use UDP instead of TCP"
	default n
	depends on NET_UDP

endif
```

## examples/wificonn/Kconfig
```kconfig
config EXAMPLES_WIFICONN
	tristate "wificonn: one-shot WiFi connect helper"
	default n
	depends on WIRELESS_WAPI
	---help---
		Connect to a WPA2 AP with a single command:
		  wificonn <ssid> <password>

if EXAMPLES_WIFICONN

config EXAMPLES_WIFICONN_PROGNAME
	string "Program name"
	default "wificonn"

config EXAMPLES_WIFICONN_PRIORITY
	int "Task priority"
	default 100

config EXAMPLES_WIFICONN_STACKSIZE
	int "Stack size"
	default 4096

endif
```
